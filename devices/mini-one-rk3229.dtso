/dts-v1/;
/plugin/;

#include <dt-bindings/gpio/gpio.h>
#include <dt-bindings/leds/common.h>

&{/} {

	display-client {
		#address-cells = <1>;
		#size-cells = <0>;
		compatible = "spi-gpio";
		sck-gpios = <&gpio0 0 0>;
		mosi-gpios = <&gpio0 1 0>;
		cs-gpios = <&gpio1 0 0>;
		num-chipselects = <1>;

		display-controller@24 {
			compatible = "titanmec,tm1618";
			reg = <0x24>;
			spi-3wire;
			spi-lsb-first;
			spi-rx-delay-us = <1>;
			spi-max-frequency = <500000>;

			tm16xx,digits = [04 03 01 00];
                        tm16xx,segment-mapping = [03 01 02 06 04 05 00];

			#address-cells = <2>;
			#size-cells = <0>;
			
			led@2,2 {
				reg = <2 2>;
				function = "colon";
			};

		};
	};
};

