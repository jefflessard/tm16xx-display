/dts-v1/;
/plugin/;

#include <dt-bindings/gpio/gpio.h>
#include <dt-bindings/leds/common.h>

&{/} {

	display_client: spi {
		#address-cells = <1>;
		#size-cells = <0>;
		compatible = "spi-gpio";
		sck-gpios = <&gpio 71 0>;
		mosi-gpios = <&gpio 72 0>;
		cs-gpios = <&gpio 70 0>;
		num-chipselects = <1>;

		display-controller@0 {
			compatible = "fdhisi,fd620";
			reg = <0x0>;
			spi-3wire;
			spi-lsb-first;
			spi-rx-delay-us = <1>;
			spi-max-frequency = <500000>;

			tm16xx,digits = [00 01 02 03];
                        tm16xx,segment-mapping = [03 01 02 06 04 05 00];

			#address-cells = <2>;
			#size-cells = <0>;
			
			led@4,4 {
				reg = <4 4>;
				function = "colon";
			};

		};
	};
};

