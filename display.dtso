/dts-v1/;
/plugin/;

#include <dt-bindings/gpio/gpio.h>
#include <dt-bindings/leds/common.h>

&{/} {

	display-client {
		#address-cells = <1>;
		#size-cells = <0>;

// choose one of the following block depending on the chip client protocol

// i2c client: uncomment the following block
/*
		compatible = "i2c-gpio";
		sda-gpios = <&gpio_ao 0x05 GPIO_ACTIVE_HIGH>;
		scl-gpios = <&gpio_ao 0x04 GPIO_ACTIVE_HIGH>;
		i2c-gpio,delay-us = <5>;

		display-controller@24 {
			compatible = "fuda,fd6551";
			// or // compatible = "titan,tm1650"";
			reg = <0x24>;
			/include/ "t95-display.dtsi"
		};
*/

// spi client: uncomment the following block
/*
		compatible = "spi-gpio";
		sck-gpios = <&gpio 4 GPIO_ACTIVE_HIGH>;
		mosi-gpios = <&gpio 3 GPIO_ACTIVE_HIGH>;
		cs-gpios = <&gpio 2 GPIO_ACTIVE_LOW>;
		num-chipselects = <1>;

		display-controller@24 {
			compatible = "titan,tm1628";
			reg = <0x24>;
			spi-3wire;
			spi-lsb-first;
			spi-rx-delay-us = <1>;
			spi-max-frequency = <500000>;
			/include/ "t95-display.dtsi"
		};
*/
	};
};

