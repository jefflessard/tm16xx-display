## Documentation/devicetree/bindings/auxdisplay/titanmec,tm16xx.yaml
```yaml
# SPDX-License-Identifier: (GPL-2.0-only OR BSD-2-Clause)
%YAML 1.2
---
$id: http://devicetree.org/schemas/auxdisplay/titanmec,tm16xx.yaml#
$schema: http://devicetree.org/meta-schemas/core.yaml#

title: Auxiliary displays based on TM16xx and compatible LED controllers

maintainers:
  - Jean-François Lessard <jefflessard3@gmail.com>

description: |
  LED matrix controllers used in auxiliary display devices that drive
  individual LED icons and 7-segment digit groups through a grid/segment
  addressing scheme. The controller's physical capabilities (grid count,
  segment count, brightness levels) are determined by the compatible string.

  Board-specific LED wiring is described through child nodes that specify
  grid/segment coordinates for individual icons and segment mapping for
  7-segment digits.
  TM16xx controllers manage a matrix of LEDs organized in grids (rows) and segments (columns).
  Each grid or segment can be wired to drive either a digit or individual icons, depending on the
  board design.

  Typical display example:

           ---    ---       ---    ---
    WIFI  |   |  |   |  -  |   |  |   |  USB  PLAY
           ---    ---       ---    ---
    LAN   |   |  |   |  -  |   |  |   |  BT   PAUSE
           ---    ---       ---    ---

  The controller itself is agnostic of the display layout. The specific arrangement
  (which grids and segments drive which digits or icons) is determined by the board-level
  wiring. Therefore, these bindings describe hardware configuration at the PCB level
  to enable support of multiple display implementations using these LED controllers.

properties:
  compatible:
    enum:
      - titanmec,tm1618
      - titanmec,tm1620
      - titanmec,tm1628
      - titanmec,tm1650
      - fdhisi,fd620
      - fdhisi,fd628
      - fdhisi,fd650
      - fdhisi,fd6551
      - fdhisi,fd655
      - icore,aip650
      - icore,aip1618
      - icore,aip1628
      - princeton,pt6964
      - winrise,hbs658

  reg:
    maxItems: 1

  digits:
    type: object
    description: Container for 7-segment digit group definitions

    properties:
      "#address-cells":
        const: 1
      "#size-cells":
        const: 0

    patternProperties:
      "^digit@[0-9]+$":
        type: object
        properties:
          reg:
            description: Digit position identifier
            maxItems: 1
          segments:
            $ref: /schemas/types.yaml#/definitions/uint32-matrix
            description: |
              Array of grid/segment coordinate pairs for each 7-segment position.
              Each entry is <grid segment> mapping to standard 7-segment positions
              in order: a, b, c, d, e, f, g

              Standard 7-segment layout:
                 aaa
                f   b
                f   b
                 ggg
                e   c
                e   c
                 ddd
            items:
              items:
               - description: Grid index (column/bank)
               - description: Segment index (row/bit position)
            # minItems: 2
            # maxItems: 2
            minItems: 7
            maxItems: 7
        required:
          - reg
          - segments
        unevaluatedProperties: false

    additionalProperties: false

  leds:
    type: object
    description: Container for individual LED icon definitions
    properties:
      "#address-cells":
        const: 2
      "#size-cells":
        const: 0

    patternProperties:
      "^led@[0-8],[0-9a-d]$":
        type: object
        $ref: /schemas/leds/common.yaml#
        properties:
          reg:
            description: Grid and segment indices as <grid segment> of this individual LED icon
        required:
          - reg
        unevaluatedProperties: false

    additionalProperties: false

if:
  properties:
    compatible:
      contains:
        enum:
          - titanmec,tm1618
          - titanmec,tm1620
          - titanmec,tm1628
          - fdhisi,fd620
          - fdhisi,fd628
          - icore,aip1618
          - icore,aip1628
          - princeton,pt6964
then:
  allOf:
    - $ref: /schemas/spi/spi-peripheral-props.yaml#
  properties:
    spi-3wire: true
  required:
    - spi-3wire

allOf:
  - $ref: /schemas/input/input.yaml

required:
  - compatible
  - reg

unevaluatedProperties: false

examples:
  - |
    #include <dt-bindings/leds/common.h>

    i2c {
      #address-cells = <1>;
      #size-cells = <0>;

      display-controller@24 {
        reg = <0x24>;
        compatible = "fdhisi,fd655";

        leds {
          #address-cells = <2>;
          #size-cells = <0>;

          led@0,0 {
            reg = <0 0>;
            function = LED_FUNCTION_ALARM;
          };

          led@0,1 {
            reg = <0 1>;
            function = LED_FUNCTION_USB;
          };

          led@0,2 {
            reg = <0 2>;
            function = "play";
          };

          led@0,3 {
            reg = <0 3>;
            function = "pause";
          };

          led@0,4 {
            reg = <0 4>;
            function = "colon";
          };

          led@0,5 {
            reg = <0 5>;
            function = LED_FUNCTION_LAN;
          };

          led@0,6 {
            reg = <0 6>;
            function = LED_FUNCTION_WLAN;
          };
        };
      };
    };

  - |
    #include <dt-bindings/leds/common.h>

    spi {
      #address-cells = <1>;
      #size-cells = <0>;

      display-controller@0 {
        reg = <0x0>;
        compatible = "fdhisi,fd628";
        spi-3wire;
        spi-lsb-first;
        spi-rx-delay-us = <1>;
        spi-max-frequency = <500000>;

        leds {
          #address-cells = <2>;
          #size-cells = <0>;

          led@4,0 {
            reg = <0 4>;
            function = "apps";
          };

          led@4,1 {
            reg = <1 4>;
            function = "setup";
          };

          led@4,2 {
            reg = <2 4>;
            function = LED_FUNCTION_USB;
          };

          led@4,3 {
            reg = <3 4>;
            function = LED_FUNCTION_SD;
          };

          led@4,4 {
            reg = <4 4>;
            function = "colon";
          };

          led@4,5 {
            reg = <5 4>;
            function = "hdmi";
          };

          led@4,6 {
            reg = <6 4>;
            function = "video";
          };
        };
      };
    };
```

## Documentation/devicetree/bindings/auxdisplay/tm16xx.yaml
```yaml
# SPDX-License-Identifier: (GPL-2.0-only OR BSD-2-Clause)
%YAML 1.2
---
$id: http://devicetree.org/schemas/auxdisplay/tm16xx.yaml#
$schema: http://devicetree.org/meta-schemas/core.yaml#

title: Auxiliary displays based on TM16xx and compatible LED controllers

maintainers:
  - Jean-François Lessard <jefflessard3@gmail.com>

description: |
  TM16xx controllers manage a matrix of LEDs organized in grids (rows) and segments (columns).
  Each grid or segment can be wired to drive either a digit or individual icons, depending on the
  board design.

  Typical display example:

           ---    ---       ---    ---
    WIFI  |   |  |   |  -  |   |  |   |  USB  PLAY
           ---    ---       ---    ---
    LAN   |   |  |   |  -  |   |  |   |  BT   PAUSE
           ---    ---       ---    ---
  
  The controller itself is agnostic of the display layout. The specific arrangement
  (which grids and segments drive which digits or icons) is determined by the board-level
  wiring. Therefore, these bindings describe hardware configuration at the PCB level
  to enable support of multiple display implementations using these LED controllers.

properties:
  compatible:
    enum:
      - titanmec,tm1618
      - titanmec,tm1620
      - titanmec,tm1628
      - titanmec,tm1650
      - fdhisi,fd620
      - fdhisi,fd628
      - fdhisi,fd650
      - fdhisi,fd6551
      - fdhisi,fd655
      - wxi-core,aip1628
      - princeton,pt6964
      - winrise,hbs658

  reg:
    maxItems: 1

  tm16xx,digits:
    description: |
      Array of grid (row) indexes corresponding to  specific wiring of digits in the display matrix.
      Defines which grid lines are connected to digit elements.
    $ref: /schemas/types.yaml#/definitions/uint8-array
    items:
      minimum: 0
      maximum: 7
    minItems: 1
    maxItems: 8

  tm16xx,segment-mapping:
    description: |
      Array of segment (column) indexes specifying the hardware layout mapping used for digit display.
      Each entry gives the segment index corresponding to a standard 7-segment element (a-g).
    $ref: /schemas/types.yaml#/definitions/uint8-array
    items:
      minimum: 0
      maximum: 7
    minItems: 7
    maxItems: 7

  tm16xx,transposed:
    description: |
      Optional flag indicating if grids and segments are swapped compared to standard matrix orientation.
      This accommodates devices where segments are wired to rows and grids to columns.
    $ref: /schemas/types.yaml#/definitions/flag

  "#address-cells":
    const: 2

  "#size-cells":
    const: 0

patternProperties:
  "^led@[0-7],[0-7]$":
    $ref: /schemas/leds/common.yaml#
    properties:
      reg:
        description: Grid (row) and segment (column) index in the matrix of this individual LED icon
    required:
      - reg

required:
  - compatible
  - reg
  - tm16xx,digits
  - tm16xx,segment-mapping

additionalProperties: true

examples:
  - |
    display_client: i2c {
        #address-cells = <1>;
        #size-cells = <0>;

        display@24 {
            compatible = "titanmec,tm1650";
            reg = <0x24>;
            tm16xx,digits = /bits/ 8 <0 1 2 3>;
            tm16xx,segment-mapping = /bits/ 8 <0 1 2 3 4 5 6>;

            #address-cells = <2>;
            #size-cells = <0>;

            led@4,0 {
                reg = <4 0>;
                function = "lan";
            };

            led@4,1 {
                reg = <4 1>;
                function = "wlan";
            };
        };
    };
  - |
    display_client: spi {
        #address-cells = <1>;
        #size-cells = <0>;

        display@0 {
            compatible = "titanmec,tm1628";
            reg = <0>;
            tm16xx,transposed;
            tm16xx,digits = /bits/ 8 <1 2 3 4>;
            tm16xx,segment-mapping = /bits/ 8 <0 1 2 3 4 5 6>;

            #address-cells = <2>;
            #size-cells = <0>;

            led@0,2 {
                reg = <0 2>;
                function = "usb";
            };

            led@0,3 {
                reg = <0 3>;
                function = "power";
            };
        };
    };
```

## drivers/auxdisplay/Kconfig
```kconfig
config TM16XX
	tristate "TM16XX-compatible 7-segment LED controllers with keyscan"
	depends on SPI || I2C
	depends on INPUT
	select NEW_LEDS
	select LEDS_CLASS
	select LEDS_TRIGGERS
	select INPUT_MATRIXKMAP
	select TM16XX_KEYPAD if (INPUT)
	select TM16XX_I2C if (I2C)
	select TM16XX_SPI if (SPI)
	help
	  This driver supports the following TM16XX compatible
	  I2C and SPI 7-segment led display chips:
	  - Titanmec: TM1618, TM1620, TM1628, TM1638, TM1650
	  - Fuda Hisi: FD620, FD628, FD650, FD655, FD6551
	  - i-Core: AiP650, AiP1618, AiP1628
	  - Princeton: PT6964
	  - Winrise: HBS658

	  This driver can also be built as a module. If so, the module
	  will be called tm16xx.

config TM16XX_KEYPAD
	bool
	depends on TM16XX

config TM16XX_I2C
	tristate
	depends on TM16XX

config TM16XX_SPI
	tristate
	depends on TM16XX
```
