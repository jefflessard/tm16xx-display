/dts-v1/;
/plugin/;

#include <dt-bindings/gpio/gpio.h>
#include <dt-bindings/leds/common.h>
#include <dt-bindings/gpio/meson-gxl-gpio.h>
#
&{/} {

	display-client {
		compatible = "i2c-gpio";
		sda-gpios = <&gpio_ao GPIOAO_5 GPIO_ACTIVE_HIGH>;
		scl-gpios = <&gpio_ao GPIOAO_4 GPIO_ACTIVE_HIGH>;
		i2c-gpio,delay-us = <5>;
		#address-cells = <1>;
		#size-cells = <0>;

		display-controller@24 {
			compatible = "fuda,fd6551";
			reg = <0x24>;
			/include/ "t95-display.dtsi"
		};
	};
};

